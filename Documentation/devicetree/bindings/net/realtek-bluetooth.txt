## Documentation/devicetree/bindings/net/realtek-bluetooth.txt
```
Realtek Bluetooth Chips
-----------------------

This documents the binding structure and common properties for serial
attached Realtek devices.

Serial attached Realtek devices shall be a child node of the host UART
device the slave device is attached to. See ../serial/slave-device.txt
for more information

Required properties:
- compatible: should contain one of the following:
    * "realtek,rtl8723bs-bluetooth"
    * "realtek,rtl8723ds-bluetooth"

Optional properties:
- realtek,config-data: Bluetooth chipset configuration data which is
			needed for communication (it typically contains
			board specific settings like the baudrate and
			whether flow-control is used).
			This is an array of u8 values.
- enable-gpios: GPIO specifier, used to enable/disable the BT module
- reset-gpios: GPIO specifier, used to reset the BT module


Example:

&uart {
	...

	bluetooth {
		compatible = "realtek,rtl8723bs-bluetooth";
		enable-gpios = <&gpio 20 GPIO_ACTIVE_HIGH>;
		reset-gpios = <&gpio 11 GPIO_ACTIVE_HIGH>;
		realtek,config-data = /bits/ 8 <
			0x55 0xab 0x23 0x87 0x29 0x00 0xf4 0x00 0x01 0x01 0xf6 0x00
			0x02 0x81 0x00 0xfa 0x00 0x02 0x12 0x80 0x0c 0x00 0x10 0x02
			0x80 0x92 0x04 0x50 0xc5 0xea 0x19 0xe1 0x1b 0xfd 0xaf 0x5f
			0x01 0xa4 0x0b 0xd9 0x00 0x01 0x0f 0xe4 0x00 0x01 0x08>;
	};
};
```

## Documentation/devicetree/bindings/sound/rt5651.txt
```
RT5651 audio CODEC

This device supports I2C only.

Required properties:

- compatible : "realtek,rt5651".

- reg : The I2C address of the device.

Optional properties:

- realtek,in2-differential
  Boolean. Indicate MIC2 input are differential, rather than single-ended.

- realtek,dmic-en
  Boolean. true if dmic is used.

- realtek,jack-detect-source
  u32. Valid values:
  1: Use JD1_1 pin for jack-dectect
  2: Use JD1_2 pin for jack-dectect
  3: Use JD2 pin for jack-dectect

Pins on the device (for linking into audio routes) for RT5651:

  * DMIC L1
  * DMIC R1
  * IN1P
  * IN2P
  * IN2N
  * IN3P
  * HPOL
  * HPOR
  * LOUTL
  * LOUTR
  * PDML
  * PDMR

Example:

codec: rt5651@1a {
	compatible = "realtek,rt5651";
	reg = <0x1a>;
	realtek,dmic-en = "true";
	realtek,in2-diff = "false";
};
```

## drivers/gpu/drm/gm12u320/Kconfig
```kconfig
config DRM_GM12U320
	tristate "Grain Media GM12U320 based mini projectors"
	depends on DRM
	depends on USB_SUPPORT
	depends on USB_ARCH_HAS_HCD
	select USB
	select DRM_KMS_HELPER
	help
	  This is a KMS driver for Grain Media GM12U320 based usb mini video
	  projectors, such as the Acer C120.
	  Say M/Y to add support for these devices via drm/kms interfaces.
```

## drivers/iio/common/cros_ec_sensors/Kconfig
```kconfig
#
# Chrome OS Embedded Controller managed sensors library
#
config IIO_CROS_EC_SENSORS_CORE
	tristate "ChromeOS EC Sensors Core"
	depends on SYSFS && MFD_CROS_EC
	select IIO_BUFFER
	select IIO_TRIGGERED_BUFFER
	help
	  Base module for the ChromeOS EC Sensors module.
	  Contains core functions used by other IIO CrosEC sensor
	  driver.
	  Define common attributes and sysfs interrupt handler.

config IIO_CROS_EC_SENSORS
	tristate "ChromeOS EC Sensors"
	select IIO_CROS_EC_SENSORS_CORE
	help
	  Module to handle 3d contiguous sensors like
	  Accelerometers, Gyroscope and Magnetometer that are
	  presented by the ChromeOS EC Sensor hub.
	  Create an IIO device for each funcions.



config IIO_CROS_EC_SENSORS_RING
	tristate "ChromeOS EC Sensors Ring"
	depends on IIO_CROS_EC_SENSORS
	help
	  Add support for handling sensor events FIFO produced by
	  the sensor hub.
	  A single device with a buffer will collect all samples produced
	  by the sensors managed by the CroEC sensor hub.
```

## drivers/mux/Kconfig
```kconfig
#
# Multiplexer devices
#

config MULTIPLEXER
	tristate

menu "Multiplexer drivers"
	depends on MULTIPLEXER

config MUX_ADG792A
	tristate "Analog Devices ADG792A/ADG792G Multiplexers"
	depends on I2C
	help
	  ADG792A and ADG792G Wide Bandwidth Triple 4:1 Multiplexers

	  The driver supports both operating the three multiplexers in
	  parallel and operating them independently.

	  To compile the driver as a module, choose M here: the module will
	  be called mux-adg792a.

config MUX_GPIO
	tristate "GPIO-controlled Multiplexer"
	depends on GPIOLIB || COMPILE_TEST
	help
	  GPIO-controlled Multiplexer controller.

	  The driver builds a single multiplexer controller using a number
	  of gpio pins. For N pins, there will be 2^N possible multiplexer
	  states. The GPIO pins can be connected (by the hardware) to several
	  multiplexers, which in that case will be operated in parallel.

	  To compile the driver as a module, choose M here: the module will
	  be called mux-gpio.

config MUX_CHT_USB_MUX
	tristate "Intel Cherrytrail USB Multiplexer"
	depends on ACPI && X86 && EXTCON
	help
	  This driver adds support for the internal USB mux for muxing the OTG
	  USB data lines between the xHCI host controller and the dwc3 gadget
	  controller found on Intel Cherrytrail SoCs.

	  To compile the driver as a module, choose M here: the module will
	  be called mux-intel_cht_usb_mux.

config MUX_MMIO
	tristate "MMIO register bitfield-controlled Multiplexer"
	depends on (OF && MFD_SYSCON) || COMPILE_TEST
	help
	  MMIO register bitfield-controlled Multiplexer controller.

	  The driver builds multiplexer controllers for bitfields in a syscon
	  register. For N bit wide bitfields, there will be 2^N possible
	  multiplexer states.

	  To compile the driver as a module, choose M here: the module will
	  be called mux-mmio.

config MUX_PI3USB30532
	tristate "Pericom PI3USB30532 Type-C cross switch driver"
	depends on I2C
	help
	  This driver adds support for the Pericom PI3USB30532 Type-C cross
	  switch / mux chip found on some devices with a Type-C port.

	  To compile the driver as a module, choose M here: the module will
	  be called mux-pi3usb30532.

endmenu
```

## drivers/platform/Kconfig
```kconfig
# drivers/platform/Kconfig

if X86
source "drivers/platform/x86/Kconfig"
endif
if MIPS
source "drivers/platform/mips/Kconfig"
endif
if GOLDFISH
source "drivers/platform/goldfish/Kconfig"
endif

source "drivers/platform/chrome/Kconfig"

config CHROMEOS
	bool
	depends on CHROMEOS_OF_FIRMWARE || (NVRAM && ACPI_CHROMEOS)

	---help---
	  Provides abstracted interfaces to the firmware features provided on
	  ChromeOS devices. It depends on a lowlevel driver to implement the
	  firmware interface on the platform.
```

## drivers/usb/roles/Kconfig
```kconfig
if USB_ROLE_SWITCH

config USB_ROLES_INTEL_CHT
	tristate "Intel Cherrytrail USB Role Switch"
	depends on ACPI && X86 && EXTCON
	help
	  Driver for the internal USB role switch for switching the USB data
	  lines between the xHCI host controller and the dwc3 gadget controller
	  found on Intel Cherrytrail SoCs.

	  To compile the driver as a module, choose M here: the module will
	  be called intel-cht-usb-role-switch.

endif # USB_ROLE_SWITCH
```

## drivers/usb/typec/mux/Kconfig
```kconfig
menu "USB Type-C Multiplexer/DeMultiplexer Switch support"

config TYPEC_MUX_PI3USB302
	tristate "Pericom PI3USB302_A Mux/DeMux Switch"
	help
	  Say Y or M if your system has Pericom PI3USB302_A 2-differential
	  channel bi-directional multiplexer/demultiplexer switch for USB 3.0
	  signals.

endmenu
```

## sound/soc/intel/Kconfig
```kconfig
config SND_SOC_INTEL_SST_TOPLEVEL
	bool "Intel ASoC SST drivers"
	default y
	depends on X86 || COMPILE_TEST
	select SND_SOC_INTEL_MACH
	help
	  Intel ASoC SST Platform Drivers. If you have a Intel machine that
	  has an audio controller with a DSP and I2S or DMIC port, then
	  enable this option by saying Y

	  Note that the answer to this question doesn't directly affect the
	  kernel: saying N will just cause the configurator to skip all
	  the questions about Intel SST drivers.

if SND_SOC_INTEL_SST_TOPLEVEL

config SND_SST_IPC
	tristate
	# This option controls the IPC core for HiFi2 platforms

config SND_SST_IPC_PCI
	tristate
	select SND_SST_IPC
	# This option controls the PCI-based IPC for HiFi2 platforms
	#  (Medfield, Merrifield).

config SND_SST_IPC_ACPI
	tristate
	select SND_SST_IPC
	# This option controls the ACPI-based IPC for HiFi2 platforms
	# (Baytrail, Cherrytrail)

config SND_SOC_INTEL_SST_ACPI
	tristate
	# This option controls ACPI-based probing on
	# Haswell/Broadwell/Baytrail legacy and will be set
	# when these platforms are enabled

config SND_SOC_INTEL_SST
	tristate

config SND_SOC_INTEL_SST_FIRMWARE
	tristate
	select DW_DMAC_CORE
	# This option controls firmware download on
	# Haswell/Broadwell/Baytrail legacy and will be set
	# when these platforms are enabled

config SND_SOC_INTEL_HASWELL
	tristate "Haswell/Broadwell Platforms"
	depends on SND_DMA_SGBUF
	depends on DMADEVICES && ACPI
	select SND_SOC_INTEL_SST
	select SND_SOC_INTEL_SST_ACPI
	select SND_SOC_INTEL_SST_FIRMWARE
	select SND_SOC_ACPI_INTEL_MATCH
	help
	  If you have a Intel Haswell or Broadwell platform connected to
	  an I2S codec, then enable this option by saying Y or m. This is
	  typically used for Chromebooks. This is a recommended option.

config SND_SOC_INTEL_BAYTRAIL
	tristate "Baytrail (legacy) Platforms"
	depends on DMADEVICES && ACPI
	select SND_SOC_INTEL_SST
	select SND_SOC_INTEL_SST_ACPI
	select SND_SOC_INTEL_SST_FIRMWARE
	select SND_SOC_ACPI_INTEL_MATCH
	help
	  If you have a Intel Baytrail platform connected to an I2S codec,
	  then enable this option by saying Y or m. This was typically used
	  for Baytrail Chromebooks but this option is now deprecated and is
	  not recommended, use SND_SST_ATOM_HIFI2_PLATFORM instead.

config SND_SST_ATOM_HIFI2_PLATFORM_PCI
	tristate "PCI HiFi2 (Medfield, Merrifield) Platforms"
	depends on X86 && PCI
	select SND_SST_IPC_PCI
	select SND_SOC_COMPRESS
	select SND_SOC_INTEL_COMMON
	help
	  If you have a Intel Medfield or Merrifield/Edison platform, then
	  enable this option by saying Y or m. Distros will typically not
	  enable this option: Medfield devices are not available to
	  developers and while Merrifield/Edison can run a mainline kernel with
	  limited functionality it will require a firmware file which
	  is not in the standard firmware tree

config SND_SST_ATOM_HIFI2_PLATFORM
	tristate "ACPI HiFi2 (Baytrail, Cherrytrail) Platforms"
	depends on X86 && ACPI
	select SND_SST_IPC_ACPI
	select SND_SOC_COMPRESS
	select SND_SOC_ACPI_INTEL_MATCH
	select IOSF_MBI
	help
	  If you have a Intel Baytrail or Cherrytrail platform with an I2S
	  codec, then enable this option by saying Y or m. This is a
	  recommended option

config SND_SOC_INTEL_SKYLAKE
	tristate "All Skylake+ platforms"
	depends on PCI && ACPI
	select SND_SOC_INTEL_SKL
	select SND_SOC_INTEL_BXT
	select SND_SOC_INTEL_KBL
	select SND_SOC_INTEL_GLK
	select SND_SOC_INTEL_CNL
	help
	  This configuration is a backwards compatible shortcut to enable all
	  SKL+ platform and machine drivers. Say n if you prefer to select
	  which drivers will be enabled (e.g. to reduce the number of modules
	  or for coexistence with SOF)

if SND_SOC_INTEL_SKYLAKE=n

menu "Skylake+ platform selection"

config SND_SOC_INTEL_SKL_PLATFORM
	tristate "SkyLake Platforms"
	depends on SND_SOC_INTEL_SKYLAKE_PLATFORMS
	depends on PCI && ACPI
	select SND_SOC_INTEL_SKL
	help
	  If you have a Intel Skylake platform with the DSP enabled
	  in the BIOS, then enable this option by saying Y or m.
	  This is a recommended option

config SND_SOC_INTEL_BXT_PLATFORM
	tristate "Broxton/ApolloLake Platforms"
	depends on PCI && ACPI
	select SND_SOC_INTEL_BXT
	help
	  If you have a Intel Broxton/ApolloLake platform with the DSP enabled
	  in the BIOS, then enable this option by saying Y or m.
	  This is a recommended option

config SND_SOC_INTEL_KBL_PLATFORM
	tristate "KabyLake/CoffeeLake Platforms"
	depends on PCI && ACPI
	select SND_SOC_INTEL_KBL
	help
	  If you have a Intel KabyLake/CoffeeLake platform with the DSP enabled
	  in the BIOS, then enable this option by saying Y or m.
	  This is a recommended option

config SND_SOC_INTEL_GLK_PLATFORM
	tristate "GeminiLake Platforms"
	depends on PCI && ACPI
	select SND_SOC_INTEL_GLK
	help
	  If you have a Intel GeminiLake platform with the DSP enabled
	  in the BIOS, then enable this option by saying Y or m.
	  This is a recommended option

config SND_SOC_INTEL_CNL_PLATFORM
	tristate "CannonLake Platforms"
	depends on PCI && ACPI
	select SND_SOC_INTEL_CNL
	help
	  If you have a Intel CannonLake platform with the DSP enabled
	  in the BIOS, then enable this option by saying Y or m.
	  This is a recommended option

endmenu

endif ## !SND_SOC_INTEL_SKYLAKE

config SND_SOC_INTEL_SKL
	tristate
	select SND_SOC_INTEL_SKYLAKE_GENERIC

config SND_SOC_INTEL_BXT
	tristate
	select SND_SOC_INTEL_SKYLAKE_GENERIC

config SND_SOC_INTEL_KBL
	tristate
	select SND_SOC_INTEL_SKYLAKE_GENERIC

config SND_SOC_INTEL_GLK
	tristate
	select SND_SOC_INTEL_SKYLAKE_GENERIC

config SND_SOC_INTEL_CNL
	tristate
	select SND_SOC_INTEL_SKYLAKE_GENERIC


config SND_SOC_INTEL_SKYLAKE_GENERIC
	tristate
	select SND_HDA_EXT_CORE
	select SND_HDA_DSP_LOADER
	select SND_SOC_TOPOLOGY
	select SND_SOC_INTEL_SST
	select SND_SOC_ACPI_INTEL_MATCH
	help
	  If you have a Intel Skylake/Broxton/ApolloLake/KabyLake/
	  GeminiLake or CannonLake platform with the DSP enabled in the BIOS
	  then enable this option by saying Y or m.

config SND_SOC_ACPI_INTEL_MATCH
	tristate
	select SND_SOC_ACPI if ACPI
	# this option controls the compilation of ACPI matching tables and
	# helpers and is not meant to be selected by the user.

endif ## SND_SOC_INTEL_SST_TOPLEVEL

# ASoC codec drivers
source "sound/soc/intel/boards/Kconfig"
```

## sound/soc/sof/Kconfig
```kconfig
config SND_SOC_SOF_PCI
	tristate

config SND_SOC_SOF_ACPI
	tristate

config SND_SOC_SOF_PLATFORM
	tristate

config SND_SOC_SOF_NOCODEC
	tristate

config SND_SOC_SOF
	tristate "Sound Open Firmware Support"
	default m
	select SND_SOC_TOPOLOGY
	select SND_SOC_COMPRESS
	select SND_SOC_SOF_NOCODEC
	help
          This adds support for SOF
          Say Y if you have such a device.
          If unsure select "N".

config SND_SOC_SOF_INTEL
	tristate "SOF support for Intel audio DSPs"
	depends on SND_SOC_SOF
	help
          This adds support for Sound Open Firmware for Intel(R) platforms.
          Say Y if you have such a device.
          If unsure select "N".

config SND_SOC_SOF_BAYTRAIL
	tristate "SOF support for Baytrail, Braswell and Cherrytrail"
	depends on SND_SOC_SOF_INTEL
	select SND_SOC_SOF_ACPI
	help
          This adds support for Sound Open Firmware for Intel(R) platforms
          using the Baytrail, Braswell or Cherrytrail processors.
          Say Y if you have such a device.
          If unsure select "N".

config SND_SOC_SOF_HASWELL
	tristate "SOF support for Haswell"
	depends on SND_SOC_SOF_INTEL
	select SND_SOC_SOF_ACPI
	help
          This adds support for Sound Open Firmware for Intel(R) platforms
          using the Haswell processors.
          Say Y if you have such a device.
          If unsure select "N".

config SND_SOC_SOF_BROADWELL
	tristate "SOF support for Broadwell"
	depends on SND_SOC_SOF_INTEL
	select SND_SOC_SOF_ACPI
	help
          This adds support for Sound Open Firmware for Intel(R) platforms
          using the Broadwell processors.
          Say Y if you have such a device.
          If unsure select "N".

config SND_SOC_SOF_APOLLOLAKE
	tristate "SOF support for Apollolake"
	depends on SND_SOC_SOF_INTEL
	select SND_SOC_SOF_PCI
	help
          This adds support for Sound Open Firmware for Intel(R) platforms
          using the Apollolake processors.
          Say Y if you have such a device.
          If unsure select "N".
```
